## samples/zigbee/network_coordinator/sample.yaml
```yaml
sample:
  description: Zigbee Light control - coordinator sample
  name: Zigbee Network coordinator
tests:
  sample.zigbee.network_coordinator:
    build_only: true
    integration_platforms:
      - nrf52840dk_nrf52840
      - nrf5340dk_nrf5340_cpuapp
    platform_allow: nrf52840dk_nrf52840 nrf5340dk_nrf5340_cpuapp
    tags: ci_build smoke
```

## samples/zigbee/shell/sample.yaml
```yaml
sample:
  description: Zigbee application thast includes all Zigbee shell commands
  name: Zigbee application with Zigbee shell
tests:
  sample.zigbee.shell:
    build_only: true
    integration_platforms:
      - nrf52840dk_nrf52840
      - nrf5340dk_nrf5340_cpuapp
    platform_allow: nrf52840dk_nrf52840 nrf5340dk_nrf5340_cpuapp
    tags: ci_build shell
```

## samples/zigbee/template/sample.yaml
```yaml
sample:
  description: Zigbee application template
  name: Zigbee application template
tests:
  sample.zigbee.template:
    build_only: true
    integration_platforms:
      - nrf52840dk_nrf52840
      - nrf5340dk_nrf5340_cpuapp
    platform_allow: nrf52840dk_nrf52840 nrf5340dk_nrf5340_cpuapp
    tags: ci_build smoke
```
